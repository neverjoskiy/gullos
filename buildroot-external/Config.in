## buildroot-external/Config.in
```kconfig
menu "GullOS Userland Packages"
	source "$BR2_EXTERNAL_GULLOS_PATH/package/gull-sh/Config.in"
	source "$BR2_EXTERNAL_GULLOS_PATH/package/gull-term/Config.in"
	source "$BR2_EXTERNAL_GULLOS_PATH/package/gull-lock/Config.in"
endmenu
```

## buildroot-external/package/gull-lock/Config.in
```kconfig
config BR2_PACKAGE_GULL_LOCK
	bool "gull-lock"
	default y
	help
	  Custom Wayland session lockscreen for GullOS (ext-session-lock-v1 with
	  wlr-layer-shell fallback) styled in Catppuccin Mocha.
```

## buildroot-external/package/gull-sh/Config.in
```kconfig
config BR2_PACKAGE_GULL_SH
	bool "gull-sh"
	default y
	help
	  Custom Fish-inspired interactive shell for GullOS featuring real-time
	  Catppuccin Mocha syntax highlighting, Tab completion, and persistent
	  command history (~/.gull_history).
```

## buildroot-external/package/gull-term/Config.in
```kconfig
config BR2_PACKAGE_GULL_TERM
	bool "gull-term"
	default y
	select BR2_PACKAGE_GULL_SH
	help
	  Custom Wayland terminal emulator for GullOS styled in Catppuccin Mocha
	  that spawns gull-sh via PTY and falls back cleanly to raw Linux TTY mode
	  when launched outside a Wayland display server.
```
